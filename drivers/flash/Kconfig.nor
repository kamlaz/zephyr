## drivers/flash/Kconfig.nor
```kconfig
# Copyright (c) 2018 Savoir-Faire Linux.
# SPDX-License-Identifier: Apache-2.0
#--------------
menuconfig QSPI
	bool "QSPI hardware bus support"
	select HAS_DTS_QSPI
	help
	  Enable support for the QSPI hardware bus.

if QSPI

config QSPI_ASYNC
	bool "Enable Asynchronous call support"
	select POLL
	help
	  This option enables the asynchronous API calls.


config QSPI_INIT_PRIORITY
	int "Init priority"
	default 70
	help
	  Device driver initialization priority.

module = QSPI
module-str = qspi
source "subsys/logging/Kconfig.template.log_config"


config	QSPI_0
	bool "QSPI port 0"
	help
	  Enable QSPI controller port 0.

source "drivers/flash/Kconfig.nrfx"


endif # QSPI
#--------------
menuconfig QSPI_NOR
	bool "QSPI NOR Flash"
	select FLASH_HAS_DRIVER_ENABLED
	depends on QSPI

if QSPI_NOR

config QSPI_NOR_INIT_PRIORITY
	int
	default 80
	help
	  Device driver initialization priority.
	  Device is connected to SPI bus, it has to
	  be initialized after SPI driver.

config QSPI_NOR_CS_WAIT_DELAY
	int "Delay time in us"
	default 0
	help
	This is the wait delay (in us) to allow for CS switching to take effect

config QSPI_NOR_FLASH_LAYOUT_PAGE_SIZE
	int "Page size to use for FLASH_LAYOUT feature"
	default 65536
	help
	  When CONFIG_FLASH_PAGE_LAYOUT is used this driver will support
	  that API.  By default the page size corresponds to the block
	  size (65536).  Other options include the 32K-byte erase size
	  (32768), and the sector size (4096).

config QSPI_NOR_PAGE_SIZE
	int "Page size of QSPI flash"
	default 0
	help
	  Note: This option is deprecated and is ignored.  Page size is
	  always 256.

config QSPI_NOR_SECTOR_SIZE
	int "Sector size of QSPI flash"
	default 0
	help
	  Note: This option is deprecated and is ignored.  Sector size
	  is always 4096.

endif # QSPI_NOR

menuconfig SPI_NOR
	bool "SPI NOR Flash"
	select FLASH_HAS_DRIVER_ENABLED
	depends on SPI

if SPI_NOR

config SPI_NOR_INIT_PRIORITY
	int
	default 80
	help
	  Device driver initialization priority.
	  Device is connected to SPI bus, it has to
	  be initialized after SPI driver.

config SPI_NOR_CS_WAIT_DELAY
	int "Delay time in us"
	default 0
	help
	  This is the wait delay (in us) to allow for CS switching to take effect

config SPI_NOR_FLASH_LAYOUT_PAGE_SIZE
	int "Page size to use for FLASH_LAYOUT feature"
	default 65536
	help
	  When CONFIG_FLASH_PAGE_LAYOUT is used this driver will support
	  that API.  By default the page size corresponds to the block
	  size (65536).  Other options include the 32K-byte erase size
	  (32768), the sector size (4096), or any non-zero multiple of the
	  sector size.

config SPI_NOR_IDLE_IN_DPD
	bool "Use Deep Power-Down mode when flash is not being accessed."
	help
	  Where supported deep power-down mode can reduce current draw
	  to as little as 0.1% of standby current.  However it takes
	  some milliseconds to enter and exit from this mode.

	  Select this option for applications where device power
	  management is not enabled, the flash remains inactive for
	  long periods, and when used the impact of waiting for mode
	  enter and exit delays is acceptable.

endif # SPI_NOR
```

## drivers/flash/Kconfig.nordic_qspi_nor
```kconfig
# Copyright (c) 2019, Nordic Semiconductor ASA
# SPDX-License-Identifier: Apache-2.0

menuconfig QSPI
	bool "QSPI hardware bus support"
	select HAS_DTS_QSPI
	help
	  Enable support for the QSPI hardware bus.

if QSPI

config QSPI_ASYNC
	bool "Enable Asynchronous call support"
	select POLL
	help
	  This option enables the asynchronous API calls.

config QSPI_INIT_PRIORITY
	int "Init priority"
	default 70
	help
	  Device driver initialization priority.

module = QSPI
module-str = qspi
source "subsys/logging/Kconfig.template.log_config"


config	QSPI_0
	bool "QSPI port 0"
	help
	  Enable QSPI controller port 0.

source "drivers/flash/Kconfig.nrfx"


endif # QSPI

menuconfig QSPI_NOR
	bool "QSPI NOR Flash"
	select FLASH_HAS_DRIVER_ENABLED
	depends on QSPI

if QSPI_NOR

config QSPI_NOR_INIT_PRIORITY
	int
	default 80
	help
	  Device driver initialization priority.
	  Device is connected to SPI bus, it has to
	  be initialized after SPI driver.

config QSPI_NOR_CS_WAIT_DELAY
	int "Delay time in us"
	default 0
	help
	This is the wait delay (in us) to allow for CS switching to take effect

config QSPI_NOR_FLASH_LAYOUT_PAGE_SIZE
	int "Page size to use for FLASH_LAYOUT feature"
	default 65536
	help
	  When CONFIG_FLASH_PAGE_LAYOUT is used this driver will support
	  that API.  By default the page size corresponds to the block
	  size (65536).  Other options include the 32K-byte erase size
	  (32768), and the sector size (4096).

config QSPI_NOR_PAGE_SIZE
	int "Page size of QSPI flash"
	default 0
	help
	  Note: This option is deprecated and is ignored.  Page size is
	  always 256.

config QSPI_NOR_SECTOR_SIZE
	int "Sector size of QSPI flash"
	default 0
	help
	  Note: This option is deprecated and is ignored.  Sector size
	  is always 4096.

endif # QSPI_NOR
```

## drivers/qspi/Kconfig
```kconfig
# Kconfig - QSPI driver configuration options

#
# Copyright (c) 2015-2016 Intel Corporation
#
# SPDX-License-Identifier: Apache-2.0
#

#
# QSPI Drivers
#
menuconfig QSPI
	bool "QSPI hardware bus support"
	select HAS_DTS_QSPI
	help
	  Enable support for the QSPI hardware bus.

if QSPI

config QSPI_ASYNC
	bool "Enable Asynchronous call support"
	select POLL
	help
	  This option enables the asynchronous API calls.


config QSPI_INIT_PRIORITY
	int "Init priority"
	default 70
	help
	  Device driver initialization priority.

module = QSPI
module-str = qspi
source "subsys/logging/Kconfig.template.log_config"


config	QSPI_0
	bool "QSPI port 0"
	help
	  Enable QSPI controller port 0.

if QSPI_0

config QSPI_0_OP_MODES
	int "Port 0 supported operation modes (master/slave/both)"
	default 1
	range 1 3
	help
	  This sets the supported operation modes at runtime, by the QSPI
	  port 0, where:
	  1 is MASTER mode only (default)
	  2 is SLAVE mode only
	  3 is both modes are available.

endif # QSPI_0



source "drivers/qspi/Kconfig.nrfx"


endif # QSPI
```

## drivers/qspi/Kconfig.nrfx
```kconfig
# Copyright (c) 2017 - 2018, Nordic Semiconductor ASA
#
# SPDX-License-Identifier: Apache-2.0
#

menuconfig QSPI_NRFX
	bool "nRF QSPI nrfx drivers"
	default y
	depends on SOC_FAMILY_NRF
	help
	  Enable support for nrfx QSPI drivers for nRF MCU series.
	  Peripherals with the same instance ID cannot be used together,
	  e.g. QSPI_0 and I2C_0. You may need to disable I2C_0 or I2C_1.

if QSPI_NRFX

choice
	prompt "QSPI Port 0 Driver type"

config QSPI_NRF_QSPI
	bool "nRF QSPI"
	depends on HAS_HW_NRF_QSPI
	select NRFX_QSPI
	help
	  Enable nRF QSPI Master without EasyDMA on port 0.

config QSPI_0_NRF_QSPI
	bool "nRF QSPI 0"
	depends on HAS_HW_NRF_QSPI0
	select NRFX_QSPI
	help
	  Enable nRF QSPI Master without EasyDMA on port 0.

endchoice

if QSPI_0_NRF_QSPI

config QSPI_0_NRF_ORC
	hex "QSPI Port 0 over-read character"
	range 0x00 0xff
	default 0xff
	help
	  Over-read character. Character clocked out after an over-read
	  of the transmit buffer.

endif # QSPI_0_NRF_QSPI


endif # QSPI_NRFX
```

## dts/bindings/mtd/jedec,qspi-nor.yaml
```yaml
# Copyright (c) 2019 Nordic Semiconductor ASA
# SPDX-License-Identifier: Apache-2.0

title: QSPI NOR flash devices (JEDEC CFI interface)

description: >
  Any QSPI NOR flash that supports the JEDEC CFI interface.

compatible: "jedec,qspi-nor"

include: qspi-device.yaml

properties:

  cs-pin:
    type: int
    required: true
    description: RESETn pin

  frequency:
    type: int
    required: true
    description: Specify operational frequency

  qspi-mode:
    type: int
    required: true
    description: Specify desired QSPI mode

  data-lines:
    type: int
    required: true
    description: Specify how many data lines are used

  address-size:
    type: int
    required: true
    description: Specify how many bits are used for addressing

  cs-high-time:
    type: int
    required: true
    description: Specify how longs CS pin must stay high between two QSPI operations(in numbers of qspi clock cycles)

  jedec-id:
    type: uint8-array
    required: true
    description: JEDEC ID as manufacturer ID, memory type, memory density

  size:
    type: int
    required: true
    description: Flash capacity in bits

  has-be32k:
    type: boolean
    required: false
    description: Indicates the device supports the BE32K command

  has-ddr-mode:
    type: boolean
    required: false
    description: Indicates the device supports DDR mode
```

## dts/bindings/qspi/nordic,nrf-qspi.yaml
```yaml
# Copyright (c) 2018 Nordic Semiconductor ASA
# SPDX-License-Identifier: Apache-2.0

title: Nordic nRF Family QSPI Master node

description: >
    This is a representation of the Nordic nRF SPI node

compatible: "nordic,nrf-qspi"

include: qspi-controller.yaml

properties:
    reg:
      required: true

    interrupts:
      required: true

    csn-pin:
      type: int
      required: true
      description: CSN pin

    sck-pin:
      type: int
      required: true
      description: SCK pin

    io00-pin:
      type: int
      required: true
      description: IO00 pin

    io01-pin:
      type: int
      required: true
      description: IO01 pin

    io02-pin:
      type: int
      required: true
      description: IO02 pin

    io03-pin:
      type: int
      required: true
      description: IO03 pin
```

## dts/bindings/qspi/qspi-controller.yaml
```yaml
# Copyright (c) 2018, I-SENSE group of ICCS
# SPDX-License-Identifier: Apache-2.0

# Common fields for QSPI controllers

include: base.yaml

child:
    bus: qspi

properties:
    clock-frequency:
      type: int
      required: false
      description: Clock frequency the QSPI peripheral is being driven at
    "#address-cells":
      required: true
      const: 1
    "#size-cells":
      required: true
      const: 0
    label:
      required: true
    cs-gpios:
      type: phandle-array
      required: false
```

## dts/bindings/qspi/qspi-device.yaml
```yaml
# Copyright (c) 2018, I-SENSE group of ICCS
# SPDX-License-Identifier: Apache-2.0

# Common fields for SPI devices

include: base.yaml

parent-bus: qspi

properties:
    reg:
      required: true
    qspi-max-frequency:
      type: int
      required: true
      description: Maximum clock frequency of device's QSPI interface in Hz
    label:
      required: true
```

## dts/bindings/qspi/qspi.yaml
```yaml
#
# Copyright (c) 2018, I-SENSE group of ICCS
#
# SPDX-License-Identifier: Apache-2.0
#

title: QSPI Base Structure

description: >
    This binding gives the base structures for all QSPI devices

inherits:
    !include base.yaml

child:
    bus: qspi

properties:
    clock-frequency:
      type: int
      category: optional
      description: Clock frequency the QSPI peripheral is being driven at
    "#address-cells":
      type: int
      category: required
      description: should be 1.
    "#size-cells":
      type: int
      category: required
      description: should be 0.
    label:
      category: required
    cs-gpios:
      type: compound
      category: optional
```

## tests/drivers/flash/qspi_flash/testcase.yaml
```yaml
tests:
  peripheral.qspi_flash:
    platform_whitelist: nrf52840_pca10056
    tags: driver
```
